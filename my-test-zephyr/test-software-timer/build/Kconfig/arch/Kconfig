## my-test-zephyr/test-software-timer/build/Kconfig/arch/Kconfig
```kconfig
# Load arch Kconfig descriptions.
osource "/home/giang/zephyrproject/zephyr/arch/x86/Kconfig"
osource "/home/giang/zephyrproject/zephyr/arch/xtensa/Kconfig"
osource "/home/giang/zephyrproject/zephyr/arch/sparc/Kconfig"
osource "/home/giang/zephyrproject/zephyr/arch/riscv/Kconfig"
osource "/home/giang/zephyrproject/zephyr/arch/posix/Kconfig"
osource "/home/giang/zephyrproject/zephyr/arch/nios2/Kconfig"
osource "/home/giang/zephyrproject/zephyr/arch/mips/Kconfig"
osource "/home/giang/zephyrproject/zephyr/arch/arm64/Kconfig"
osource "/home/giang/zephyrproject/zephyr/arch/arm/Kconfig"
osource "/home/giang/zephyrproject/zephyr/arch/arc/Kconfig"
```
